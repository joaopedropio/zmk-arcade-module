## boards/shields/arcade_adapter/Kconfig.shield
```kconfig
config SHIELD_ARCADE_ADAPTER
    def_bool $(shields_list_contains,arcade_adapter)
```

## boards/shields/pacman_adapter/Kconfig.shield
```kconfig
config SHIELD_PACMAN_ADAPTER
    def_bool $(shields_list_contains,pacman_adapter)
```

## dts/bindings/audio/pacman,max98357a.yaml
```yaml
# Copyright (c) 2025 The ZMK Contributors
# SPDX-License-Identifier: MIT

description: |
  A MAX98357A hung off an I2S port.

  The amplifier has no control interface - it takes I2S in and drives a
  speaker out - so all this node carries is which I2S port feeds it and, if
  the board wires one, the pin that shuts it down.  SD_MODE also selects the
  channel through the resistor next to it; left alone the part sums left and
  right, which is what this module sends.

compatible: "pacman,max98357a"

include: base.yaml

properties:
  i2s:
    type: phandle
    required: true
    description: the I2S port the amplifier is wired to

  sd-gpios:
    type: phandle-array
    description: |
      SD_MODE, if the board brings it out.  Driven high while something is
      playing and low the rest of the time, which keeps the amplifier from
      hissing between sounds.
```
