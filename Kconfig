## Kconfig
```kconfig
# Arcade dongle module options.
#
# Every symbol is prefixed with ARCADE_ so this module can live next to
# other dongle modules without fighting over Kconfig names.

config ARCADE_SHELL
    bool "An `arcade` command on the shell"
    depends on SHELL
    default y
    help
      Reads and writes the settings the dongle remembers - the theme, the
      mute, which widget is in which slot - so they can be changed over a
      serial connection instead of by rebuilding.  The theme and the mute
      take effect as you type; the rest are stored and drawn on the next
      boot, because every slot widget allocates its scratch bitmap from the
      slot it was given at init.

      Only the shell backend costs anything: turn CONFIG_SHELL on and this
      comes with it.  On a dongle that means a CDC ACM endpoint over the USB
      it is already plugged into.

config ARCADE_PROFILE_SLOTS
    int "How many profiles the dongle can hold"
    default 5
    range 1 16
    help
      A profile is every setting at once under a name, written to flash so it
      travels with the dongle rather than with the browser that made it.  Each
      one costs about eight hundred bytes of the storage partition when it is
      used, and nothing while the slot is empty.

config ARCADE_ROTATE_DISPLAY
    int "Rotate the display (0, 90, 180 or 270)"
    default 0

config ARCADE_FRAME_INTERVAL
    int "Milliseconds between frames"
    default 33
    help
      33 ms is roughly 30 frames per second.  Raise it for a calmer,
      cheaper animation, lower it for a snappier one.

config ARCADE_SOUND
    bool "Drive the I2S amplifier"
    default y
    select I2S
    help
      Needs a MAX98357A (or anything else that takes I2S straight in) on the
      pins the shield's arcade_amp node names.  With no amplifier in the
      devicetree this does nothing either way.

config ARCADE_SOUND_VOLUME
    int "How loud, 0 to 100"
    default 80
    range 0 100
    help
      100 is unity: one voice at full tilt reaches full scale on its own, and
      a limiter catches whatever stacks on top of it.  80 is the default
      because the last 2 dB above it costs more squashing than it is worth.
      Take the rest from the amplifier: GAIN tied to GND instead of left
      floating is 6 dB and does not touch the waveform.

config ARCADE_SOUND_BASS_FLOOR_HZ
    int "Lowest pitch worth sending to the speaker"
    default 0
    range 0 4000
    help
      A small speaker radiates almost nothing below its own resonance, so a
      note written down there reaches it as silence that has still cost mixing
      headroom.  Notes below this are doubled until they clear it, which keeps
      the intervals - a chord stays that chord, voiced higher.

      The lower of the two chirp notes is D5, at 587 Hz, which most small
      drivers manage - so there is little here for this to fix.  It is kept
      for a score of your own in tools/tunes.py that does go low.

config ARCADE_SOUND_CONNECT
    bool "Chirp when a keyboard connects or drops off"
    default y
    help
      Two chime notes rising when a half reports in, the same shape falling
      when it goes away, so the dongle tells you the link dropped without your
      having to look at it.

      The dongle is the central and ZMK announces the split connection only on
      the peripheral side, so this reads it off the battery level instead: 0
      means gone.  A half sitting at a genuine 0% therefore reads as gone,
      which is the same bargain the battery readout already makes.  Nothing
      sounds at power-on, when the halves connecting is not news.

config ARCADE_MUTE_THRESHOLD
    int "Milliseconds of hold that mute and unmute the speaker"
    default 600
    help
      The third and longest press on the action button, past the short one
      that opens the dashboard and the medium one that changes theme.  Muting
      stops whatever is sounding; unmuting chirps, so you can tell it worked.
      The setting is saved, so a muted dongle comes back muted.

      Set it to 0 to leave the button with its two actions and no mute.

config ARCADE_SOUND_SAMPLE_RATE
    int "Samples per second"
    default 16000
    help
      The nRF I2S clock cannot hit every rate exactly and the driver picks the
      closest it can.  16 kHz is plenty for square waves and keeps the blocks
      small.

config ARCADE_WPM_SPEED
    bool "Speed the game up while you type"
    default y

config ARCADE_WPM_SLOW
    int "Words per minute below which the game idles"
    default 20

config ARCADE_WPM_FAST
    int "Words per minute above which the game runs fast"
    default 60

config ARCADE_DEFAULT_GAME
    string "Which game the panel plays"
    default "pacman"
    help
      "pacman" is the maze, "shooter" is the meteors, "bomber" is the brick
      field, "fighter" is the two of them on a stage, "commando" is the run
      along the ridge, "frogger" is the road and the river, "kong" is the
      girders and "tempest" is the well.  All of them are
      self-playing animations on the same panel and any of them can be chosen
      later from the shell or the configurator, so this is only what a freshly
      flashed dongle comes up on.

# ------------------------------------------------------------------
# The maze's colours.
# ------------------------------------------------------------------

config ARCADE_BG_COLOR
    string "Background colour (rrggbb)"
    default "000000"

config ARCADE_WALL_COLOR
    string "Maze wall outline colour (rrggbb)"
    default "2121de"

config ARCADE_WALL_FILL_COLOR
    string "Maze wall fill colour (rrggbb)"
    default "00003c"

config ARCADE_WALL_FLASH_COLOR
    string "Maze colour while it flashes at the end of a level (rrggbb)"
    default "f8f8f8"

config ARCADE_HOUSE_COLOR
    string "Ghost house outline colour (rrggbb)"
    default "6d6dff"

config ARCADE_DOOR_COLOR
    string "Ghost house door colour (rrggbb)"
    default "ffb8ff"

config ARCADE_PELLET_COLOR
    string "Pellet colour (rrggbb)"
    default "ffb897"

config ARCADE_PACMAN_COLOR
    string "Pac-Man colour (rrggbb)"
    default "ffee00"

config ARCADE_GHOST_0_COLOR
    string "First ghost colour (rrggbb)"
    default "ff0000"

config ARCADE_GHOST_1_COLOR
    string "Second ghost colour (rrggbb)"
    default "ffb8ff"

config ARCADE_GHOST_2_COLOR
    string "Third ghost colour (rrggbb)"
    default "00ffff"

config ARCADE_GHOST_3_COLOR
    string "Fourth ghost colour (rrggbb)"
    default "ffb852"

config ARCADE_FRIGHT_COLOR
    string "Colour of a frightened ghost (rrggbb)"
    default "2121de"

# ------------------------------------------------------------------
# The shooter's colours.  Cool hull, hot exhaust, grey rock: the three
# families are what let the ship, its flame and a meteor be told apart
# at a glance, and a palette that keeps them apart will read at arm's
# length whatever the individual colours are.
# ------------------------------------------------------------------

config ARCADE_SPACE_COLOR
    string "Colour behind the stars (rrggbb)"
    default "05060f"

config ARCADE_STAR_COLOR
    string "Star colour (rrggbb)"
    default "8899bb"

config ARCADE_SHIP_COLOR
    string "Ship hull colour (rrggbb)"
    default "6ee7ff"

config ARCADE_SHIP_TRIM_COLOR
    string "Ship cockpit colour (rrggbb)"
    default "ffffff"

config ARCADE_THRUSTER_COLOR
    string "Exhaust flame colour (rrggbb)"
    default "ff8a1f"

config ARCADE_BULLET_COLOR
    string "Shot colour (rrggbb)"
    default "fff36b"

config ARCADE_METEOR_COLOR
    string "Meteor fill colour (rrggbb)"
    default "5a5f7a"

config ARCADE_METEOR_EDGE_COLOR
    string "Meteor rim colour (rrggbb)"
    default "a3adc9"

config ARCADE_BLAST_COLOR
    string "Colour of a meteor coming apart (rrggbb)"
    default "ff5a2b"

config ARCADE_POWERUP_COLOR
    string "Pickup and shield colour (rrggbb)"
    default "39ff9e"

config ARCADE_HUD_COLOR
    string "Score and lives colour (rrggbb)"
    default "ffee00"
    help
      Shared with the crossing, which puts the same two things in the same
      place - so a palette only has to have an opinion about it once.

# ------------------------------------------------------------------
# The crossing's colours.  Four of them are the board itself and the
# rest are what moves on it; the board's four are the ones to get
# right, because water that does not read as water is a game about a
# frog hopping into a blue rectangle.  Shades between them - ripples,
# grain, windows, a sinking turtle - are derived from these rather
# than stored, so there is nothing here that can disagree with itself.
# ------------------------------------------------------------------

config ARCADE_WATER_COLOR
    string "River colour (rrggbb)"
    default "1030a8"

config ARCADE_ROAD_COLOR
    string "Road colour, and the two readout bands (rrggbb)"
    default "101014"

config ARCADE_BANK_COLOR
    string "The two safe strips, and the clock bar (rrggbb)"
    default "1f7a3a"

config ARCADE_HEDGE_COLOR
    string "Colour of the hedge the home bays are cut into (rrggbb)"
    default "0f5a2a"

config ARCADE_FROG_COLOR
    string "Frog colour (rrggbb)"
    default "7bf03c"

config ARCADE_FROG_EYE_COLOR
    string "Frog's eyes (rrggbb)"
    default "ffffff"

config ARCADE_LOG_COLOR
    string "Log colour (rrggbb)"
    default "8a5a2b"

config ARCADE_TURTLE_COLOR
    string "Turtle colour (rrggbb)"
    default "f0a020"

config ARCADE_CAR_COLOR
    string "Car colour; the racing cars are a lighter shade of it (rrggbb)"
    default "e03c3c"

config ARCADE_TRUCK_COLOR
    string "Truck colour (rrggbb)"
    default "d8d8e0"

config ARCADE_SPLAT_COLOR
    string "Colour of what is left where the frog was (rrggbb)"
    default "ffffff"

config ARCADE_FLY_COLOR
    string "Colour of the fly in a home bay (rrggbb)"
    default "ff40c0"

# ------------------------------------------------------------------
# The bomber's colours.  Three families again, and here they are what
# the board is made of rather than what stands on it: ground, hard
# wall and soft wall have to be told apart at a glance, because which
# of the two walls is in the way is the whole of what the bomber is
# deciding.  The flame is the one thing allowed to shout.
# ------------------------------------------------------------------

config ARCADE_FLOOR_COLOR
    string "Colour of ground a bomb has cleared (rrggbb)"
    default "1c6b2a"

config ARCADE_SOLID_COLOR
    string "Pillar and border colour (rrggbb)"
    default "9aa2ad"

config ARCADE_BRICK_COLOR
    string "Soft wall colour (rrggbb)"
    default "b5561e"

config ARCADE_BRICK_EDGE_COLOR
    string "Colour of the joints between its bricks (rrggbb)"
    default "6e2f10"

config ARCADE_BOMB_COLOR
    string "Bomb colour (rrggbb)"
    default "14161c"

config ARCADE_FLAME_COLOR
    string "Blast colour (rrggbb)"
    default "ff6a00"

config ARCADE_FLAME_HOT_COLOR
    string "Colour of the core of a blast, and of a lit fuse (rrggbb)"
    default "ffe066"

config ARCADE_BOMBER_COLOR
    string "Bomber colour (rrggbb)"
    default "f2f2f2"

config ARCADE_BOMBER_TRIM_COLOR
    string "Colour of its visor, which is the way it is facing (rrggbb)"
    default "1e73ff"

config ARCADE_FOE_COLOR
    string "Enemy colour (rrggbb)"
    default "e23b6d"

config ARCADE_FOE_EYE_COLOR
    string "Enemy eye colour (rrggbb)"
    default "ffffff"

config ARCADE_PICKUP_COLOR
    string "Colour of whatever was under a soft wall (rrggbb)"
    default "00d2ff"

config ARCADE_EXIT_COLOR
    string "Colour of the way out (rrggbb)"
    default "ffd400"

# ------------------------------------------------------------------
# The ring's colours.  The one place on this dongle where telling two
# of the same shape apart is the whole point, so the two fighters get
# a body and a trim each rather than a colour and a shade of it - and
# the stage behind them is deliberately quiet, because everything
# worth looking at happens in the forty pixels above the floor.
# ------------------------------------------------------------------

config ARCADE_RING_COLOR
    string "Colour of the backdrop above the stage (rrggbb)"
    default "2a1a4a"

config ARCADE_RING_CROWD_COLOR
    string "Colour of the wall behind the stage (rrggbb)"
    default "53306b"

config ARCADE_RING_FLOOR_COLOR
    string "Colour of the stage itself (rrggbb)"
    default "8a5a2b"

config ARCADE_FIGHTER_0_COLOR
    string "First fighter's colour (rrggbb)"
    default "f2f2f2"

config ARCADE_FIGHTER_0_TRIM_COLOR
    string "Its headband, belt and guard (rrggbb)"
    default "d42a2a"

config ARCADE_FIGHTER_1_COLOR
    string "Second fighter's colour (rrggbb)"
    default "ffcf3f"

config ARCADE_FIGHTER_1_TRIM_COLOR
    string "Its headband, belt and guard (rrggbb)"
    default "1e73ff"

config ARCADE_SPARK_COLOR
    string "Colour of a hit landing, and of the stage flashing (rrggbb)"
    default "fff4c2"

config ARCADE_FIREBALL_COLOR
    string "Fireball colour (rrggbb)"
    default "4fd8ff"

config ARCADE_HEALTH_COLOR
    string "Colour of what is left of a health bar (rrggbb)"
    default "ffe000"

config ARCADE_HEALTH_LOST_COLOR
    string "Colour of what is draining out of one (rrggbb)"
    default "d03020"

# ------------------------------------------------------------------
# The ridge's colours.  Split by what can be walked on and what
# cannot: the ground and its lit top are two settings rather than one
# and a shade, because on a night raid the lit top is the only thing
# separating the ridge from the dark it is standing in.
# ------------------------------------------------------------------

config ARCADE_SKY_COLOR
    string "Sky colour over the ridge (rrggbb)"
    default "2c4a72"

config ARCADE_HILL_COLOR
    string "Colour of the skyline behind it (rrggbb)"
    default "3f5f4a"

config ARCADE_GROUND_COLOR
    string "Colour of the ground the trooper runs on (rrggbb)"
    default "6b5233"

config ARCADE_GROUND_EDGE_COLOR
    string "Colour of the lit top of it (rrggbb)"
    default "9e8b52"

config ARCADE_HERO_COLOR
    string "Trooper colour (rrggbb)"
    default "d8e0c0"

config ARCADE_HERO_TRIM_COLOR
    string "Its helmet and rifle (rrggbb)"
    default "2f6b2f"

config ARCADE_GRUNT_COLOR
    string "Enemy colour (rrggbb)"
    default "c44a3a"

config ARCADE_GRUNT_TRIM_COLOR
    string "Its cap and weapon (rrggbb)"
    default "2a1a14"

config ARCADE_SHOT_COLOR
    string "Colour of a round in the air (rrggbb)"
    default "ffe066"

config ARCADE_GRENADE_COLOR
    string "Grenade colour (rrggbb)"
    default "4a4a4a"

config ARCADE_BOOM_COLOR
    string "Colour of something going off (rrggbb)"
    default "ff7a1f"

config ARCADE_CRATE_COLOR
    string "Colour of a crate of grenades (rrggbb)"
    default "00c8b4"

# ------------------------------------------------------------------
# The girders' colours.  Sorted by what a barrel does to you rather
# than by what is on screen: the girders and the ladders are the two
# things underfoot and have to be told apart at a glance, because
# which of them the climber is on is the whole of what he is deciding,
# and the barrels are the one thing allowed to shout.
# ------------------------------------------------------------------

config ARCADE_SITE_COLOR
    string "Colour behind the girders (rrggbb)"
    default "000000"

config ARCADE_GIRDER_COLOR
    string "Girder colour; the rivets are a shade of it (rrggbb)"
    default "d83030"

config ARCADE_LADDER_COLOR
    string "Ladder colour (rrggbb)"
    default "30c0f0"

config ARCADE_CLIMBER_COLOR
    string "Climber colour (rrggbb)"
    default "e03030"

config ARCADE_CLIMBER_TRIM_COLOR
    string "His overalls and his face (rrggbb)"
    default "3060e0"

config ARCADE_BARREL_COLOR
    string "Barrel colour, and the flame over the drum (rrggbb)"
    default "d08020"

config ARCADE_APE_COLOR
    string "Colour of whatever is throwing them (rrggbb)"
    default "a05820"

config ARCADE_APE_TRIM_COLOR
    string "Its face and chest (rrggbb)"
    default "f0c088"

config ARCADE_LADY_COLOR
    string "Colour of the one at the top (rrggbb)"
    default "f060a0"

config ARCADE_HAMMER_COLOR
    string "Hammer colour (rrggbb)"
    default "f0d040"

config ARCADE_DRUM_COLOR
    string "Colour of the drum at the foot of the site (rrggbb)"
    default "2060d0"

# ------------------------------------------------------------------
# The well's colours.  This is the one game here drawn entirely in
# lines, and at the far end of the tube everything in it is four
# pixels across - so colour is all there is to tell a flipper from a
# tanker, and the four enemies get four settings rather than a family
# and shades of it.
# ------------------------------------------------------------------

config ARCADE_VOID_COLOR
    string "Colour outside the well (rrggbb)"
    default "000000"

config ARCADE_WELL_COLOR
    string "Colour of the spokes and the far end of the tube (rrggbb)"
    default "2040d0"

config ARCADE_RIM_COLOR
    string "Colour of the near rim, which is where the claw lives (rrggbb)"
    default "60a0ff"

config ARCADE_CLAW_COLOR
    string "Claw colour (rrggbb)"
    default "ffe030"

config ARCADE_CLAW_SHOT_COLOR
    string "Colour of what it fires (rrggbb)"
    default "ffffff"

config ARCADE_FLIPPER_COLOR
    string "Colour of the ones that tumble across the spokes (rrggbb)"
    default "ff3040"

config ARCADE_TANKER_COLOR
    string "Colour of the ones that break into two when shot (rrggbb)"
    default "40e060"

config ARCADE_SPIKER_COLOR
    string "Colour of the ones that build spikes (rrggbb)"
    default "30e0e0"

config ARCADE_PULSAR_COLOR
    string "Colour of the ones that electrify their lane (rrggbb)"
    default "ff40e0"

config ARCADE_SPIKE_COLOR
    string "Colour of a spike left up a lane (rrggbb)"
    default "9060ff"

config ARCADE_BOLT_COLOR
    string "Colour of what they fire, and of the superzapper (rrggbb)"
    default "ffa020"

# ------------------------------------------------------------------
# Splash screen and dashboard.  The dashboard is a grid of slots; each
# ARCADE_INFO_SLOT_* names what goes in one of them, and the colours
# below are the custom theme (theme 0).  Holding the action button
# steps through the built-in themes, which recolour all of it.
# ------------------------------------------------------------------

config ARCADE_BATTERY_BG_COLOR
    string ""
    default "000000"

config ARCADE_BATTERY_BG_COLOR_1
    string ""
    default "000000"

config ARCADE_BATTERY_BG_COLOR_2
    string ""
    default "000000"

config ARCADE_BATTERY_NUM_COLOR
    string ""
    default "ffee00"

config ARCADE_BATTERY_NUM_COLOR_1
    string ""
    default "ffee00"

config ARCADE_BATTERY_NUM_COLOR_2
    string ""
    default "ffee00"

config ARCADE_BATTERY_PERCENTAGE_COLOR
    string ""
    default "ffb897"

config ARCADE_BATTERY_PERCENTAGE_COLOR_1
    string ""
    default "ffb897"

config ARCADE_BATTERY_PERCENTAGE_COLOR_2
    string ""
    default "ffb897"

config ARCADE_BATTERY_SLOTS
    int "Battery Slots"
    default 2

config ARCADE_BATTERY_WIDGET_BG_COLOR
    string ""
    default "000000"

config ARCADE_BATTERY_WIDGET_NUM_COLOR
    string ""
    default "ffee00"

config ARCADE_BATTERY_WIDGET_NUMBER
    int ""
    default 0

config ARCADE_BATTERY_WIDGET_PERCENTAGE_COLOR
    string ""
    default "ffb897"

config ARCADE_BATTERY_WIDGET_TEXT_COLOR
    string ""
    default "ffb897"

config ARCADE_BT_BG_COLOR
    string ""
    default "000000"

config ARCADE_BT_NUM_COLOR
    string ""
    default "00ffff"

config ARCADE_BT_STATUS_BG_COLOR
    string ""
    default "000000"

config ARCADE_BT_STATUS_NOT_OK_COLOR
    string ""
    default "ff0000"

config ARCADE_BT_STATUS_OK_COLOR
    string ""
    default "00e000"

config ARCADE_BT_STATUS_OPEN_COLOR
    string ""
    default "ffb852"

config ARCADE_DASHBOARD_STYLE
    string "Dashboard style"
    default "classic"
    help
      "classic" is the configurable slot grid with the animated Pac-Man header.
      "arcade" is the fixed cabinet-HUD layout: the same six readouts drawn as
      an arcade machine's own HUD - WPM as the 1UP score, the layer as the
      STAGE, the profile as the CREDIT count, connectivity as player lamps,
      modifiers as lit buttons, the batteries as ENERGY bars.

config ARCADE_DEFAULT_SCREEN
    string "Default screen"
    default "game"

config ARCADE_FRAME_COLOR
    string ""
    default "2121de"

config ARCADE_FRAME_COLOR_1
    string ""
    default "101078"

config ARCADE_INFO_SLOT_1
    string "Info slot 1"
    default "modifiers"

config ARCADE_INFO_SLOT_2
    string "Info slot 2"
    default "theme"

config ARCADE_INFO_SLOT_3
    string "Info slot 3"
    default "wpm"

config ARCADE_INFO_SLOT_4
    string "Info slot 4"
    default "empty"

config ARCADE_INFO_SLOT_5
    string "Info slot 5"
    default "connectivity"

config ARCADE_INFO_SLOT_6
    string "Info slot 6"
    default "layer"

config ARCADE_INFO_SLOT_MODE
    string "Info slot mode"
    default "2-slot"

config ARCADE_LAYER_FONT_BG_COLOR
    string ""
    default "000000"

config ARCADE_LAYER_FONT_COLOR
    string ""
    default "ffee00"

config ARCADE_LOGO_ACCENT_COLOR
    string ""
    default "ffb897"

config ARCADE_LOGO_BG_COLOR
    string ""
    default "000000"

config ARCADE_LOGO_FONT_COLOR
    string ""
    default "ffee00"

config ARCADE_LOGO_WALK_INTERVAL
    int "Logo walk interval"
    default 50

config ARCADE_MENU_BG_COLOR
    string ""
    default "000000"

config ARCADE_MODIFIER_BG_COLOR
    string ""
    default "000000"

config ARCADE_MODIFIER_SELECTED_COLOR
    string ""
    default "ffee00"

config ARCADE_MODIFIER_UNSELECTED_COLOR
    string ""
    default "2121de"

config ARCADE_SPLASH_BG_COLOR
    string ""
    default "000000"

config ARCADE_SPLASH_CREATED_BY_COLOR
    string ""
    default "ffb897"

config ARCADE_SPLASH_STYLE
    string "Which splash goes up at boot"
    default "drawn"
    help
      "drawn" builds it out of the wordmark and the sprites, so every colour
      in it is a setting.  "image" puts up the picture in splash_image.h
      instead, which brings its own eight colours and ignores those settings.

config ARCADE_SPLASH_FRAMES
    int "Ticks the splash screen stays up"
    default 50
    help
      Times ARCADE_SPLASH_INTERVAL.  The default is two and a half seconds,
      which is long enough that LVGL's first flush of its empty screen lands
      on the splash rather than on the game.

config ARCADE_SPLASH_INTERVAL
    int "Milliseconds between splash screen ticks"
    default 50

config ARCADE_SPLASH_LOGO_COLOR
    string ""
    default "ffee00"

config ARCADE_SPLASH_MULTICOLOR_0
    string ""
    default "000000"

config ARCADE_SPLASH_MULTICOLOR_1
    string ""
    default "2121de"

config ARCADE_SPLASH_MULTICOLOR_2
    string ""
    default "ffee00"

config ARCADE_SPLASH_MULTICOLOR_3
    string ""
    default "ff0000"

config ARCADE_SYMBOL_BG_COLOR
    string ""
    default "000000"

config ARCADE_SYMBOL_SELECTED_COLOR
    string ""
    default "ffee00"

config ARCADE_SYMBOL_UNSELECTED_COLOR
    string ""
    default "2121de"

config ARCADE_THEME_BG_COLOR
    string "Theme background color"
    default "000000"

config ARCADE_THEME_BG_DARKER_COLOR
    string "Theme background darker color"
    default "000000"

config ARCADE_THEME_FONT_BG_COLOR
    string ""
    default "000000"

config ARCADE_THEME_FONT_COLOR
    string ""
    default "ffb897"

config ARCADE_THEME_FONT_COLOR_1
    string ""
    default "ffee00"

config ARCADE_THEME_PRIMARY_COLOR
    string "Theme primary color"
    default "ffb897"

config ARCADE_THEME_SECONDARY_COLOR
    string "Theme secondary color"
    default "2121de"

config ARCADE_THEME_THRESHOLD
    int "Theme threshold"
    default 300

config ARCADE_USE_BATTERY_FONT_3X5
    bool "Use battery font 3x5"
    default n

config ARCADE_USE_COMPLETE_CUSTOM_THEME
    bool "Complete custom theme"
    default y

config ARCADE_WPM_FONT_1_COLOR
    string ""
    default "ffee00"

config ARCADE_WPM_FONT_BG_COLOR
    string ""
    default "000000"

config ARCADE_WPM_FONT_COLOR
    string ""
    default "ffb897"
```
